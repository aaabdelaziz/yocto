## poky/build/conf/bblayers.conf
```bitbake
# POKY_BBLAYERS_CONF_VERSION is increased each time build/conf/bblayers.conf
# changes incompatibly
POKY_BBLAYERS_CONF_VERSION = "2"

BBPATH = "${TOPDIR}"
BBFILES ?= ""

BBLAYERS ?= " \
  /home/aaaziz/yocto-project/yocto/poky/meta \
  /home/aaaziz/yocto-project/yocto/poky/meta-poky \
  /home/aaaziz/yocto-project/yocto/poky/meta-yocto-bsp \
  /home/aaaziz/yocto-project/yocto/poky/meta-openembedded/meta-oe \
  /home/aaaziz/yocto-project/yocto/poky/meta-openembedded/meta-python \
  /home/aaaziz/yocto-project/yocto/poky/meta-openembedded/meta-networking \
  /home/aaaziz/yocto-project/yocto/poky/meta-raspberrypi \
  /home/aaaziz/yocto-project/yocto/poky/meta-qt5 \
  "
```
